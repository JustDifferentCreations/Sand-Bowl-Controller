#include "ssd1306.h"
#include <avr/io.h>
#include <util/delay.h>
#include <string.h>

// === I2C Bit-Bang Configuration ===
#define SDA_PIN   2
#define SCL_PIN   3

#define SDA_HIGH() (PORTA.OUTSET = (1 << SDA_PIN))
#define SDA_LOW()  (PORTA.OUTCLR = (1 << SDA_PIN))
#define SCL_HIGH() (PORTA.OUTSET = (1 << SCL_PIN))
#define SCL_LOW()  (PORTA.OUTCLR = (1 << SCL_PIN))

#define SDA_OUTPUT() (PORTA.DIRSET = (1 << SDA_PIN))
#define SDA_INPUT()  (PORTA.DIRCLR = (1 << SDA_PIN))
#define SCL_OUTPUT() (PORTA.DIRSET = (1 << SCL_PIN))

#define SSD1306_I2C_DELAY() _delay_us(5)


// === Display Buffer ===
static uint8_t buffer[SSD1306_WIDTH * SSD1306_HEIGHT / 8];
static uint8_t cursorX = 0;
static uint8_t cursorY = 0;

// === 5x7 Font (printable ASCII 32?127) ===
// Simple 5x7 font
static const uint8_t Font5x7[][5] = {
    {0x00,0x00,0x00,0x00,0x00}, // space
    {0x00,0x00,0x5F,0x00,0x00}, // !
    {0x00,0x07,0x00,0x07,0x00}, // "
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    {0x08,0x04,0x08,0x10,0x08}, // ~
};



// === Bit-banged I2C functions ===
static void i2c_start(void)
{
    SDA_OUTPUT();
    SDA_HIGH();
    SCL_HIGH();
    SSD1306_I2C_DELAY();
    SDA_LOW();
    SSD1306_I2C_DELAY();
    SCL_LOW();
}

static void i2c_stop(void)
{
    SDA_LOW();
    SCL_HIGH();
    SSD1306_I2C_DELAY();
    SDA_HIGH();
    SSD1306_I2C_DELAY();
}

static void i2c_writeByte(uint8_t data)
{
    for (uint8_t i = 0; i < 8; i++)
    {
        if (data & 0x80) SDA_HIGH(); else SDA_LOW();
        SCL_HIGH();
        SSD1306_I2C_DELAY();
        SCL_LOW();
        SSD1306_I2C_DELAY();
        data <<= 1;
    }

    // ACK bit (ignore value)
    SDA_INPUT();
    SCL_HIGH();
    SSD1306_I2C_DELAY();
    SCL_LOW();
    SDA_OUTPUT();
}

static void ssd1306_command(uint8_t cmd)
{
    i2c_start();
    i2c_writeByte(SSD1306_ADDR << 1);
    i2c_writeByte(0x00); // command control byte
    i2c_writeByte(cmd);
    i2c_stop();
}

static void ssd1306_data(uint8_t data)
{
    i2c_start();
    i2c_writeByte(SSD1306_ADDR << 1);
    i2c_writeByte(0x40); // data control byte
    i2c_writeByte(data);
    i2c_stop();
}

// === SSD1306 Core ===
void SSD1306_Init(void)
{
    ssd1306_command(0xAE);           // Display OFF
    ssd1306_command(0xD5);           // Set display clock divide ratio/oscillator frequency
    ssd1306_command(0x80);
    ssd1306_command(0xA8);           // Set multiplex ratio
    ssd1306_command(0x1F);           // 1/32 duty for 128x32
    ssd1306_command(0xD3);           // Set display offset
    ssd1306_command(0x00);
    ssd1306_command(0x40 | 0x00);    // Set display start line to 0
    ssd1306_command(0x8D);           // Charge pump
    ssd1306_command(0x14);
    ssd1306_command(0x20);           // Memory addressing mode
    ssd1306_command(0x00);           // Horizontal addressing
    ssd1306_command(0xA1);           // Segment remap (flip if mirrored)
    ssd1306_command(0xC8);           // COM scan direction (flip if upside down)
    ssd1306_command(0xDA);           // Set COM pins
    ssd1306_command(0x02);           // Correct for 128x32
    ssd1306_command(0x81);           // Contrast
    ssd1306_command(0x8F);
    ssd1306_command(0xD9);           // Pre-charge
    ssd1306_command(0xF1);
    ssd1306_command(0xDB);           // VCOMH deselect level
    ssd1306_command(0x40);
    ssd1306_command(0xA4);           // Resume to RAM content display
    ssd1306_command(0xA6);           // Normal display (not inverted)
    ssd1306_command(0xAF);           // Display ON

    SSD1306_Clear();
    SSD1306_Display();
}



void SSD1306_Clear(void)
{
    // Clear the buffer
    for(uint16_t i = 0; i < sizeof(buffer); i++) {
        buffer[i] = 0x00;
    }

    // Optional: flush immediately to display
    SSD1306_Display();
}


void SSD1306_Display(void)
{
    for(uint8_t page = 0; page < SSD1306_HEIGHT / 8; page++) {
        ssd1306_command(0xB0 + page); // page address
        ssd1306_command(0x00);        // lower column start
        ssd1306_command(0x10);        // higher column start

        for(uint8_t x = 0; x < SSD1306_WIDTH; x++) {
            ssd1306_data(buffer[page * SSD1306_WIDTH + x]);
        }
    }
}



void SSD1306_SetCursor(uint8_t x, uint8_t y)
{
    cursorX = x;
    cursorY = y;
}

void SSD1306_WriteChar(uint8_t x, uint8_t y, char c)
{
    if(c < 32 || c > 126) c = '?'; // replace unsupported chars

    uint8_t page = y / 8; // calculate page (8 pixels tall)
    uint8_t row_offset = y % 8; // vertical offset inside page

    for(uint8_t i = 0; i < 5; i++) { // 5 columns per character
        uint8_t line = Font5x7[c - 32][i];

        // write to buffer, shifting vertically if y is not page-aligned
        if(row_offset == 0) {
            buffer[page * SSD1306_WIDTH + x + i] = line;
        } else {
            buffer[page * SSD1306_WIDTH + x + i] &= (0xFF >> (8 - row_offset));
            buffer[page * SSD1306_WIDTH + x + i] |= line << row_offset;

            if(page + 1 < SSD1306_HEIGHT / 8) {
                buffer[(page + 1) * SSD1306_WIDTH + x + i] &= ~(line >> (8 - row_offset));
                buffer[(page + 1) * SSD1306_WIDTH + x + i] |= line >> (8 - row_offset);
            }
        }
    }

    // 1 pixel spacing
    buffer[page * SSD1306_WIDTH + x + 5] = 0x00;
}


void SSD1306_WriteString(uint8_t x, uint8_t y, const char *str)
{
    while(*str) {
        SSD1306_WriteChar(x, y, *str++);
        x += 6; // 5 pixels + 1 spacing
        if(x + 5 >= SSD1306_WIDTH) { // wrap to next line if needed
            x = 0;
            y += 8;
            if(y >= SSD1306_HEIGHT) break; // stop if past screen
        }
    }
}



